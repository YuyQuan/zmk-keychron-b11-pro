## app/Kconfig.behaviors
```kconfig
# Copyright (c) 2023 The ZMK Contributors
# SPDX-License-Identifier: MIT

config ZMK_BEHAVIOR_KEY_TOGGLE
    bool
    default y
    depends on DT_HAS_ZMK_BEHAVIOR_KEY_TOGGLE_ENABLED

config ZMK_BEHAVIOR_MOUSE_KEY_PRESS
    bool
    default y
    depends on DT_HAS_ZMK_BEHAVIOR_MOUSE_KEY_PRESS_ENABLED
    imply ZMK_MOUSE

config ZMK_BEHAVIOR_SENSOR_ROTATE_COMMON
    bool

config ZMK_BEHAVIOR_SENSOR_ROTATE
    bool
    default y
    depends on DT_HAS_ZMK_BEHAVIOR_SENSOR_ROTATE_ENABLED
    select ZMK_BEHAVIOR_SENSOR_ROTATE_COMMON

config ZMK_BEHAVIOR_SENSOR_ROTATE_VAR
    bool
    default y
    depends on DT_HAS_ZMK_BEHAVIOR_SENSOR_ROTATE_VAR_ENABLED
    select ZMK_BEHAVIOR_SENSOR_ROTATE_COMMON

config ZMK_BEHAVIOR_MACRO
    bool
    default y
    depends on DT_HAS_ZMK_BEHAVIOR_MACRO_ENABLED || DT_HAS_ZMK_BEHAVIOR_MACRO_ONE_PARAM_ENABLED || DT_HAS_ZMK_BEHAVIOR_MACRO_TWO_PARAM_ENABLED

config ZMK_BEHAVIOR_DYNAMIC_MACRO
    bool
    default y
    depends on DT_HAS_ZMK_BEHAVIOR_DYNAMIC_MACRO_ENABLED

if ZMK_BEHAVIOR_DYNAMIC_MACRO

config ZMK_BEHAVIOR_DYNAMIC_MACRO_TAP_DELAY
    int "Dynamic Macro Tap Delay (ms between replayed events)"
    default 30

config ZMK_BEHAVIOR_DYNAMIC_MACRO_MAX_SLOTS
    int "Dynamic Macro Max Slots"
    default 1

config ZMK_BEHAVIOR_DYNAMIC_MACRO_MAX_EVENTS
    int "Dynamic Macro Max Events (a keystroke is 2: press + release)"
    default 32

endif
```

## app/boards/shields/keychron_b11_pro_ansi/Kconfig.shield
```kconfig
config SHIELD_KEYCHRON_B11_PRO_ANSI
    def_bool $(shields_list_contains,keychron_b11_pro_ansi)
    select SHIELD_KEYCHRON_V1MAX
    select ENABLE_GPIO_LED
    select ADD_PPT_REPORT_RATE
    select COL_595_OUTPUT
    select ADAPATIVE_NKRO
```
